## drivers/soc/qcom/Kconfig
```kconfig
# When adding new entries keep the list in alphabetical order

if ARCH_MSM

config STATE_HELPER
        bool "State Helper"
	depends on STATE_NOTIFIER
	default y

config STATE_NOTIFIER
        bool "State Notifier"
	default y

endif # ARCH_MSMs
```
