## drivers/cpufreq/Kconfig
```kconfig
menu "CPU Frequency scaling"

config CPU_FREQ
	bool "CPU Frequency scaling"
	help
	  CPU Frequency scaling allows you to change the clock speed of 
	  CPUs on the fly. This is a nice method to save power, because 
	  the lower the CPU clock speed, the less power the CPU consumes.

	  Note that this driver doesn't automatically change the CPU
	  clock speed, you need to either enable a dynamic cpufreq governor
	  (see below) after boot, or use a userspace tool.

	  For details, take a look at <file:Documentation/cpu-freq>.

	  If in doubt, say N.

if CPU_FREQ

config CPU_FREQ_TABLE
	tristate

config CPU_FREQ_STAT
	tristate "CPU frequency translation statistics"
	select CPU_FREQ_TABLE
	default y
	help
	  This driver exports CPU frequency statistics information through sysfs
	  file system.

	  To compile this driver as a module, choose M here: the
	  module will be called cpufreq_stats.

	  If in doubt, say N.

config CPU_FREQ_STAT_DETAILS
	bool "CPU frequency translation statistics details"
	depends on CPU_FREQ_STAT
	help
	  This will show detail CPU frequency translation table in sysfs file
	  system.

	  If in doubt, say N.

choice
	prompt "Default CPUFreq governor"
	default CPU_FREQ_DEFAULT_GOV_USERSPACE if CPU_FREQ_SA1100 || CPU_FREQ_SA1110
	default CPU_FREQ_DEFAULT_GOV_PERFORMANCE
	help
	  This option sets which CPUFreq governor shall be loaded at
	  startup. If in doubt, select 'performance'.

config CPU_FREQ_DEFAULT_GOV_ABYSSPLUG
        bool "abyssplug"
        select CPU_FREQ_GOV_ABYSSPLUG
        select CPU_FREQ_GOV_PERFORMANCE
        ---help---
         Use the CPUFreq governor 'abyssplug' as default. This allows you
         to get a full dynamic frequency capable system with CPU
         hotplug support by simply loading your cpufreq low-level
         hardware driver. Be aware that not all cpufreq drivers
         support the hotplug governor. If unsure have a look at
         the help section of the driver. Fallback governor will be the
         performance governor.

config CPU_FREQ_DEFAULT_GOV_ABYSSPLUGV2
        bool "abyssplugv2"
        select CPU_FREQ_GOV_ABYSSPLUG
        select CPU_FREQ_GOV_PERFORMANCE
        ---help---
         Use the CPUFreq governor 'abyssplugv2' as default. This allows you
         to get a full dynamic frequency capable system with CPU
         hotplug support by simply loading your cpufreq low-level
         hardware driver. Be aware that not all cpufreq drivers
         support the hotplug governor. If unsure have a look at
         the help section of the driver. Fallback governor will be the
         performance governor.

config CPU_FREQ_DEFAULT_GOV_ALUCARD
  	bool "alucard"
  	select CPU_FREQ_GOV_ALUCARD
  	help

config CPU_FREQ_DEFAULT_GOV_BADASS
	bool "badass"
	select CPU_FREQ_GOV_BADASS
	select CPU_FREQ_GOV_PERFORMANCE
	help
	  Use the CPUFreq governor 'badass' as default. This allows
	  you to get a full dynamic frequency capable system by simply
	  loading your cpufreq low-level hardware driver.
	  Be aware that not all cpufreq drivers support the badass
	  governor. If unsure have a look at the help section of the
	  driver. Fallback governor will be the performance governor.

config CPU_FREQ_DEFAULT_GOV_CONSERVATIVE
	bool "conservative"
	select CPU_FREQ_GOV_CONSERVATIVE
	select CPU_FREQ_GOV_PERFORMANCE
	help
	  Use the CPUFreq governor 'conservative' as default. This allows
	  you to get a full dynamic frequency capable system by simply
	  loading your cpufreq low-level hardware driver.
	  Be aware that not all cpufreq drivers support the conservative
	  governor. If unsure have a look at the help section of the
	  driver. Fallback governor will be the performance governor.

config CPU_FREQ_DEFAULT_GOV_DANCEDANCE
	bool "DanceDance"
	select CPU_FREQ_GOV_DANCEDANCE

config CPU_FREQ_DEFAULT_GOV_DARKNESS
  	bool "darkness"
	select CPU_FREQ_GOV_DARKNESS
  	help

config CPU_FREQ_DEFAULT_GOV_ELEMENTALX
	bool "elementalx"
	select CPU_FREQ_GOV_ELEMENTALX
	select CPU_FREQ_GOV_PERFORMANCE
	help
	  Use the CPUFreq governor 'elementalx' as default.

config CPU_FREQ_DEFAULT_GOV_NIGHTMARE
  	bool "nightmare"
  	select CPU_FREQ_GOV_NIGHTMARE
  	help

config CPU_FREQ_DEFAULT_GOV_ONDEMAND
	bool "ondemand"
	select CPU_FREQ_GOV_ONDEMAND
	select CPU_FREQ_GOV_PERFORMANCE
	help
	  Use the CPUFreq governor 'ondemand' as default. This allows
	  you to get a full dynamic frequency capable system by simply
	  loading your cpufreq low-level hardware driver.
	  Be aware that not all cpufreq drivers support the ondemand
	  governor. If unsure have a look at the help section of the
	  driver. Fallback governor will be the performance governor.

config CPU_FREQ_DEFAULT_GOV_HELLSACTIVE
	bool "hellsactive"
	select CPU_FREQ_GOV_HELLSACTIVE
	help
	  Use the CPUFreq governor 'hellsactive' as default. This allows
	  you to get a full dynamic cpu frequency capable system by simply
	  loading your cpufreq low-level hardware driver, using the
	  'interactive' governor for latency-sensitive workloads.

config CPU_FREQ_DEFAULT_GOV_INTELLIACTIVE
	bool "intelliactive"
	select CPU_FREQ_GOV_INTELLIACTIVE
	help
	  Use the CPUFreq governor 'intelliactive' as default. This allows
	  you to get a full dynamic cpu frequency capable system by simply
	  loading your cpufreq low-level hardware driver, using the
	  'interactive' governor for latency-sensitive workloads.

config CPU_FREQ_DEFAULT_GOV_INTELLIDEMAND
	bool "intellidemand"
	select CPU_FREQ_GOV_INTELLIDEMAND
	help
	  Use the CPUFreq governor 'ondemand' as default. This allows
	  you to get a full dynamic frequency capable system by simply
	  loading your cpufreq low-level hardware driver.

config CPU_FREQ_DEFAULT_GOV_INTELLIMM
        bool "intelliminmax"
        select CPU_FREQ_GOV_INTELLIMM
        help
          Use the CPUFreq governor 'intelliminmax' as default. This is
          governor will use only 3 different frequencies, idle, UI and max

config CPU_FREQ_DEFAULT_GOV_INTERACTIVE
	bool "interactive"
	select CPU_FREQ_GOV_INTERACTIVE
	help
	  Use the CPUFreq governor 'interactive' as default. This allows
	  you to get a full dynamic cpu frequency capable system by simply
	  loading your cpufreq low-level hardware driver, using the
	  'interactive' governor for latency-sensitive workloads.

config CPU_FREQ_DEFAULT_GOV_PERFORMANCE
	bool "performance"
	select CPU_FREQ_GOV_PERFORMANCE
	help
	  Use the CPUFreq governor 'performance' as default. This sets
	  the frequency statically to the highest frequency supported by
	  the CPU.

config CPU_FREQ_DEFAULT_GOV_POWERSAVE
	bool "powersave"
	depends on EXPERT
	select CPU_FREQ_GOV_POWERSAVE
	help
	  Use the CPUFreq governor 'powersave' as default. This sets
	  the frequency statically to the lowest frequency supported by
	  the CPU.

config CPU_FREQ_DEFAULT_GOV_SMARTMAX
	bool "smartmax"
	select CPU_FREQ_GOV_SMARTMAX
	help
	  Use the CPUFreq governor 'smartmax' as default

config CPU_FREQ_DEFAULT_GOV_USERSPACE
	bool "userspace"
	select CPU_FREQ_GOV_USERSPACE
	help
	  Use the CPUFreq governor 'userspace' as default. This allows
	  you to set the CPU frequency manually or when a userspace 
	  program shall be able to set the CPU dynamically without having
	  to enable the userspace governor manually.

config CPU_FREQ_DEFAULT_GOV_YANKACTIVE
	bool "yankactive"
	select CPU_FREQ_GOV_YANKACTIVE
	help
	  Use the CPUFreq governor 'yankactive' as default. This allows
	  you to get a full dynamic cpu frequency capable system by simply
	  loading your cpufreq low-level hardware driver, using the
	  'yankactive' governor for latency-sensitive workloads.

config CPU_FREQ_DEFAULT_GOV_YANKDEMAND
	bool "yankdemand"
	select CPU_FREQ_GOV_YANKDEMAND
	select CPU_FREQ_GOV_PERFORMANCE
	help
	  Use the CPUFreq governor 'yankdemand' as default. This allows
	  you to get a full dynamic frequency capable system by simply
	  loading your cpufreq low-level hardware driver.
	  Be aware that not all cpufreq drivers support the yankdemand
	  governor. If unsure have a look at the help section of the
	  driver. Fallback governor will be the performance governor.

config CPU_FREQ_DEFAULT_GOV_ZZMOOVE
	  bool "zzmoove"
	  select CPU_FREQ_GOV_ZZMOOVE
	  select CPU_FREQ_GOV_PERFORMANCE
	  help
	  Use the CPUFreq governor 'zzmoove' as default, using predefined
	  frequency lookup tables and optimized scaling triggers instead of
	  % frequency steps to get smooth up/downscaling dependant on CPU load.

endchoice

config CPU_FREQ_GOV_ABYSSPLUG
        tristate "'abyssplug' cpufreq governor"
        depends on CPU_FREQ && NO_HZ && HOTPLUG_CPU
        ---help---
         'abyssplug' - this driver mimics the frequency scaling behavior
         in 'ondemand', but with several key differences. First is
         that frequency transitions use the CPUFreq table directly,
         instead of incrementing in a percentage of the maximum
         available frequency. Second 'abyssplug' will offline auxillary
         CPUs when the system is idle, and online those CPUs once the
         system becomes busy again. This last feature is needed for
         architectures which transition to low power states when only
         the "master" CPU is online, or for thermally constrained
         devices.
         If you don't have one of these architectures or devices, use
         'ondemand' instead.
         If in doubt, say N.

config CPU_FREQ_GOV_ABYSSPLUGV2
        tristate "'abyssplugv2' cpufreq governor"
        depends on CPU_FREQ && NO_HZ && HOTPLUG_CPU
        ---help---
         'abyssplugv2' - this driver mimics the frequency scaling behavior
         in 'ondemand', but with several key differences. First is
         that frequency transitions use the CPUFreq table directly,
         instead of incrementing in a percentage of the maximum
         available frequency. Second 'abyssplug' will offline auxillary
         CPUs when the system is idle, and online those CPUs once the
         system becomes busy again. This last feature is needed for
         architectures which transition to low power states when only
         the "master" CPU is online, or for thermally constrained
         devices.
         If you don't have one of these architectures or devices, use
         'ondemand' instead.
         If in doubt, say N.

config CPU_FREQ_GOV_ALUCARD
	tristate "'alucard' cpufreq governor"
	depends on CPU_FREQ
	  
config CPU_FREQ_GOV_BADASS
	tristate "'badass' cpufreq policy governor"
	select CPU_FREQ_TABLE
	help
	  'badass' - This driver adds a dynamic cpufreq policy governor.
	  The governor does a periodic polling and
	  changes frequency based on the CPU utilization.
	  The support for this governor depends on CPU capability to
	  do fast frequency switching (i.e, very low latency frequency	  transitions).
	  To compile this driver as a module, choose M here: the
	  module will be called cpufreq_badass.
	  If in doubt, say N.

config CPU_FREQ_GOV_BADASS_2_PHASE
	tristate "'2-phase' power-efficiency badass algorithm"
	depends on CPU_FREQ_GOV_BADASS
	help
	  '2-phase' - This driver adds a new algo to save power

config CPU_FREQ_GOV_BADASS_2_PHASE_FREQ
	int "'2-phase' badass frequency"
	default 1267200
	depends on CPU_FREQ_GOV_BADASS
	depends on CPU_FREQ_GOV_BADASS_2_PHASE

config CPU_FREQ_GOV_BADASS_3_PHASE
	tristate "'3-phase' power-efficiency badass algorithm"
	depends on CPU_FREQ_GOV_BADASS
	depends on CPU_FREQ_GOV_BADASS_2_PHASE
	help
	  '3-phase' - This driver adds a new algo to save power

config CPU_FREQ_GOV_BADASS_3_PHASE_FREQ
	int "'3-phase' badass frequency"
	default 1497600
	depends on CPU_FREQ_GOV_BADASS
	depends on CPU_FREQ_GOV_BADASS_2_PHASE
	depends on CPU_FREQ_GOV_BADASS_3_PHASE

config CPU_FREQ_GOV_BADASS_GPU_CONTROL
	tristate "'gpu_control' power-efficiency badass algorithm"
	depends on CPU_FREQ_GOV_BADASS
	depends on CPU_FREQ_GOV_BADASS_2_PHASE
	help
	  'gpu_control' - This driver adds a new algo to save power

config CPU_FREQ_GOV_BADASS_LOWBAT_POWERSAVE
	tristate "'lowbat_powersave' power-efficiency badass algorithm"
	depends on CPU_FREQ_GOV_BADASS
	help
	  'lowbat_powersave' - This driver adds a new algo to save power

config CPU_FREQ_GOV_BADASS_ALLOW_BYPASS
	tristate "Allows bypassing phases"
	depends on CPU_FREQ_GOV_BADASS
	depends on CPU_FREQ_GOV_BADASS_2_PHASE
	help
	  'allow_bypass' - This driver adds a bypass to the phases

config CPU_FREQ_GOV_CONSERVATIVE
	tristate "'conservative' cpufreq governor"
	depends on CPU_FREQ
	help
	  'conservative' - this driver is rather similar to the 'ondemand'
	  governor both in its source code and its purpose, the difference is
	  its optimisation for better suitability in a battery powered
	  environment.  The frequency is gracefully increased and decreased
	  rather than jumping to 100% when speed is required.

	  If you have a desktop machine then you should really be considering
	  the 'ondemand' governor instead, however if you are using a laptop,
	  PDA or even an AMD64 based computer (due to the unacceptable
	  step-by-step latency issues between the minimum and maximum frequency
	  transitions in the CPU) you will probably want to use this governor.

	  To compile this driver as a module, choose M here: the
	  module will be called cpufreq_conservative.

	  For details, take a look at linux/Documentation/cpu-freq.

	  If in doubt, say N.

config CPU_FREQ_GOV_DANCEDANCE
	tristate "'DanceDance' governor"
	help

config CPU_FREQ_GOV_DARKNESS
	tristate "'darkness' cpufreq governor"
	depends on CPU_FREQ

config CPU_FREQ_GOV_ELEMENTALX
	tristate "'elementalx' cpufreq policy governor"
	select CPU_FREQ_TABLE
	help
	  'elementalx' - This driver adds a dynamic cpufreq policy governor.
	  To compile this driver as a module, choose M here: the
	  module will be called cpufreq_elementalx.
	  For details, take a look at linux/Documentation/cpu-freq.
	  If in doubt, say N.

config CPU_FREQ_GOV_HELLSACTIVE
	tristate "'hellsactive' cpufreq policy governor"
	help
	  'hellsactive' - This driver adds a dynamic cpufreq policy governor
	  designed for latency-sensitive workloads.

	  This governor attempts to reduce the latency of clock
	  increases so that the system is more responsive to
	  interactive workloads.

	  To compile this driver as a module, choose M here: the
	  module will be called cpufreq_interactive.

config CPU_FREQ_GOV_INTELLIACTIVE
	tristate "'intelliactive' cpufreq policy governor"
	help
	  'intelliactive' - This driver adds a dynamic cpufreq policy governor
	  designed for latency-sensitive workloads.

	  This governor attempts to reduce the latency of clock
	  increases so that the system is more responsive to
	  interactive workloads.

	  To compile this driver as a module, choose M here: the
	  module will be called cpufreq_interactive.

	  For details, take a look at linux/Documentation/cpu-freq.

	  If in doubt, say N.

config CPU_FREQ_GOV_INTELLIDEMAND
    tristate "'intellidemand' cpufreq governor"
    depends on CPU_FREQ

config CPU_FREQ_GOV_INTELLIDEMAND
        tristate "'intellidemand' cpufreq policy governor"
        help
          'intellidemand' - This driver adds a dynamic cpufreq policy governor.
          The governor does a periodic polling and
          changes frequency based on the CPU utilization.
          The support for this governor depends on CPU capability to
          do fast frequency switching (i.e, very low latency frequency
          transitions).

config CPU_FREQ_GOV_INTELLIMM
        tristate "'intelliminmax' cpufreq policy governor"
        help
          To compile this driver as a module, choose M here: the
          module will be called cpufreq_interactive.

          For details, take a look at linux/Documentation/cpu-freq.

          If in doubt, say N.

config CPU_FREQ_GOV_INTERACTIVE
	tristate "'interactive' cpufreq policy governor"
	help
	  'interactive' - This driver adds a dynamic cpufreq policy governor
	  designed for latency-sensitive workloads.

	  This governor attempts to reduce the latency of clock
	  increases so that the system is more responsive to
	  interactive workloads.

	  To compile this driver as a module, choose M here: the
	  module will be called cpufreq_interactive.

	  For details, take a look at linux/Documentation/cpu-freq.

	  If in doubt, say N.

config CPU_FREQ_GOV_NIGHTMARE
	tristate "'nightmare' cpufreq governor"
	depends on CPU_FREQ

config CPU_FREQ_GOV_ONDEMAND
	tristate "'ondemand' cpufreq policy governor"
	select CPU_FREQ_TABLE
	help
	  'ondemand' - This driver adds a dynamic cpufreq policy governor.
	  The governor does a periodic polling and 
	  changes frequency based on the CPU utilization.
	  The support for this governor depends on CPU capability to
	  do fast frequency switching (i.e, very low latency frequency
	  transitions). 

	  To compile this driver as a module, choose M here: the
	  module will be called cpufreq_ondemand.

	  For details, take a look at linux/Documentation/cpu-freq.

	  If in doubt, say N.

config CPU_FREQ_GOV_ONDEMAND_2_PHASE
	bool "'2-phase' power-efficiency ondemand algorithm"
	depends on CPU_FREQ_GOV_ONDEMAND
	default y if ARCH_MSM_CORTEXMP
	help
	  '2-phase' - Enable this to have only 1 simple table when increasing
	  frequency according to CPU loading.

config CPU_FREQ_GOV_PERFORMANCE
	tristate "'performance' governor"
	help
	  This cpufreq governor sets the frequency statically to the
	  highest available CPU frequency.

	  To compile this driver as a module, choose M here: the
	  module will be called cpufreq_performance.

	  If in doubt, say Y.

config CPU_FREQ_GOV_POWERSAVE
	tristate "'powersave' governor"
	help
	  This cpufreq governor sets the frequency statically to the
	  lowest available CPU frequency.

	  To compile this driver as a module, choose M here: the
	  module will be called cpufreq_powersave.

	  If in doubt, say Y.

config CPU_FREQ_GOV_SMARTMAX
	tristate "'smartmax' cpufreq policy governor"
	select CPU_FREQ_TABLE
	help
	  'smartmax' combined ondemand and smartass2

config CPU_FREQ_GOV_SMARTMAX_TEGRA
	bool "'smartmax' for tegra"
	depends on CPU_FREQ_GOV_SMARTMAX

config CPU_FREQ_GOV_SMARTMAX_30
	bool "'smartmax' for 3.0 and 3.1 kernels"
	depends on CPU_FREQ_GOV_SMARTMAX

config CPU_FREQ_GOV_SMARTMAX_ENRC2B
	bool "'smartmax' defaults for enrc2b"
	depends on CPU_FREQ_GOV_SMARTMAX

config CPU_FREQ_GOV_SMARTMAX_PRIMOU
	bool "'smartmax' defaults for primou"
	depends on CPU_FREQ_GOV_SMARTMAX

config CPU_FREQ_GOV_SMARTMAX_M7
	bool "'smartmax' defaults for m7"
	depends on CPU_FREQ_GOV_SMARTMAX

config CPU_FREQ_GOV_SMARTMAX_APQ8064
	bool "'smartmax' defaults for apq8064 soc"
	depends on CPU_FREQ_GOV_SMARTMAX

config CPU_FREQ_GOV_SMARTMAX_MSM8974
	bool "'smartmax' defaults for msm8974 soc"
	depends on CPU_FREQ_GOV_SMARTMAX

config CPU_FREQ_GOV_USERSPACE
	tristate "'userspace' governor for userspace frequency scaling"
	help
	  Enable this cpufreq governor when you either want to set the
	  CPU frequency manually or when a userspace program shall
	  be able to set the CPU dynamically, like on LART 
	  <http://www.lartmaker.nl/>.

	  To compile this driver as a module, choose M here: the
	  module will be called cpufreq_userspace.

	  For details, take a look at <file:Documentation/cpu-freq/>.

	  If in doubt, say Y.
  
config CPU_FREQ_GOV_YANKDEMAND
	tristate "'yankdemand' cpufreq policy governor"
	select CPU_FREQ_TABLE
	help
	  'yankdemand' - This driver adds a dynamic cpufreq policy governor.
	  The governor is based on ondemand with just different default settings
	  and can be achieved using ondemand with a script. This is added for
	  simplification purposes for myself.

config CPU_FREQ_GOV_YANKACTIVE
	tristate "'yankactive' cpufreq policy governor"
	help
	  'yankactive' - This driver adds a dynamic cpufreq policy governor
	  designed for latency-sensitive workloads.

	  The governor is based on interactive with just different default settings
	  and can be achieved using interactive with a script. This is added for
	  simplification purposes for myself.

config CPU_FREQ_GOV_ZZMOOVE
	tristate "'zzmoove' cpufreq governor"
	depends on CPU_FREQ
	help
	  'zzmoove' - based on cpufreq_conservative, using predefined
	  frequency lookup tables and optimized scaling triggers instead of
	  % frequency steps to get smooth up/downscaling dependant on CPU load.
	  If in doubt, say N.

menu "x86 CPU frequency scaling drivers"
depends on X86
source "drivers/cpufreq/Kconfig.x86"
endmenu

menu "ARM CPU frequency scaling drivers"
depends on ARM
source "drivers/cpufreq/Kconfig.arm"
endmenu

menu "PowerPC CPU frequency scaling drivers"
depends on PPC32 || PPC64
source "drivers/cpufreq/Kconfig.powerpc"
endmenu

endif
endmenu
```
